/dts-v1/;
/plugin/;

/ {
    compatible = "ti,am335x-bone-black", "ti,am335x-bone", "ti,am33xx";

    /* 1. Cấu hình Pinmux cho 2 chân P9_24 và P9_26 sang chế độ CAN */
    fragment@0 {
        target = <&am33xx_pinmux>;
        __overlay__ {
            dcan1_pins: pinmux_dcan1_pins {
                pinctrl-single,pins = <
                    0x180 0x12  /* P9_26: d_can1_tx, Mode 2, Pullup */
                    0x184 0x32  /* P9_24: d_can1_rx, Mode 2, Input Pullup */
                >;
            };
        };
    };

    /* 2. Bật khối phần cứng DCAN1 */
    fragment@1 {
        target = <&dcan1>;
        __overlay__ {
            status = "okay";
            pinctrl-names = "default";
            pinctrl-0 = <&dcan1_pins>;
        };
    };
};
